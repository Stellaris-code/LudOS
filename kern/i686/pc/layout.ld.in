ENTRY(_start)

SECTIONS
{
    . = @KERNEL_VIRTUAL_BASE@ + 1M;

    _load_start = .;

    .mb_section ALIGN(0x4) : AT(ADDR(.mb_section) - @KERNEL_VIRTUAL_BASE@)
    {
        mbd = .;
        *(.multiboot_header)
    }
    
    .text ALIGN(0x1000) : AT(ADDR(.text) - @KERNEL_VIRTUAL_BASE@)
    {
        *(.bootcode)
        *(.text)
        *(.gnu.linkonce.t*)
    }

    .rodata ALIGN(0x1000) : AT(ADDR(.rodata) - @KERNEL_VIRTUAL_BASE@)
    {
        start_ctors = .;
        KEEP (*(SORT(.ctors*)))
        end_ctors = .;

        start_dtors = .;
        KEEP(*(SORT(.dtors*)))
        end_dtors = .;

        *(.rodata*)
        *(.gnu.linkonce.r*)
    }

    .data ALIGN(0x1000) : AT(ADDR(.data) - @KERNEL_VIRTUAL_BASE@)
    {
        data_seg = .;
        *(.data)
        *(.gnu.linkonce.d*)
    }

    _load_end = .;

    .bss : AT(ADDR(.bss) - @KERNEL_VIRTUAL_BASE@)
    {
        _bss_start = .;
        *(COMMON)
        *(.bss)
        _bss_end = .;
    }

    /DISCARD/ :
    {
        *(.comment)
        *(.eh_frame)
    }   


    kernel_virtual_end = .;
    kernel_physical_end = . - @KERNEL_VIRTUAL_BASE@;
}
